/*
*
* Copyright (c) 2023 The ZMK Contributors
* SPDX-License-Identifier: MIT
*
*/

#include "ble34.dtsi"

/{

    // chosen {
    //     zephyr,console = &cdc_acm_uart;
    // };
    

    kscan0: kscan {
        compatible = "zmk,kscan-gpio-matrix";

        diode-direction = "col2row";
        row-gpios
            = <&gpio0 20 (GPIO_ACTIVE_HIGH | GPIO_PULL_DOWN)>
            , <&gpio0 22 (GPIO_ACTIVE_HIGH | GPIO_PULL_DOWN)>
            , <&gpio0 26 (GPIO_ACTIVE_HIGH | GPIO_PULL_DOWN)>
            , <&gpio0 24 (GPIO_ACTIVE_HIGH | GPIO_PULL_DOWN)>
            ;

        col-gpios
            = <&gpio0 8 GPIO_ACTIVE_HIGH>
            , <&gpio0 12 GPIO_ACTIVE_HIGH>
            , <&gpio0 13 GPIO_ACTIVE_HIGH>
            , <&gpio0 15 GPIO_ACTIVE_HIGH>
            , <&gpio0 17 GPIO_ACTIVE_HIGH>
            ;
    };


};

// zephyr_udc0: &usbd {
    
//     cdc_acm_uart: cdc_acm_uart {
//         compatible = "zephyr,cdc-acm-uart";
//         label = "CDC_ACM_0";
//     };
//     status = "okay";
// };
