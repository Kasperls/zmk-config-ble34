## boards/arm/ble34/Kconfig
```kconfig
config BOARD_ENABLE_DCDC
    bool "Enable DCDC mode"
    select SOC_DCDC_NRF52X
    default y
    depends on (B_BLE34_LEFT || B_BLE34_RIGHT)

config BOARD_ENABLE_DCDC_HV
    bool "Enable High Voltage DCDC converter"
    select SOC_DCDC_NRF52X_HV
    default y
    depends on (B_BLE34_LEFT || B_BLE34_RIGHT)
```

## boards/arm/ble34/Kconfig.board
```kconfig
#
# Copyright (c) 2023 The ZMK Contributors
# SPDX-License-Identifier: MIT
#

config B_BLE34_LEFT
    bool "ble34_left"
    depends on SOC_NRF52840_QIAA

config B_BLE34_RIGHT
    bool "ble34_right"
    depends on SOC_NRF52840_QIAA
```

## boards/arm/ble34/Kconfig.defconfig
```kconfig
#
# Copyright (c) 2023 The ZMK Contributors
# SPDX-License-Identifier: MIT
#

if B_BLE34_LEFT

config ZMK_KEYBOARD_NAME
    default "ble34"

config ZMK_SPLIT_ROLE_CENTRAL
    default y

endif # B_BLE34_LEFT

#if B_BLE34_RIGHT

#config ZMK_KEYBOARD_NAME
#    default "ble34 right"

#endif # B_BLE34_RIGHT


if B_BLE34_LEFT || B_BLE34_RIGHT

config BOARD
    default "ble34"

config ZMK_SPLIT
    default y

#config BT_CTLR
#    default BT

#if USB

#config USB_NRFX
#    default y

#config USB_DEVICE_STACK
#    default y

#endif # USB

endif # B_BLE34_LEFT || B_BLE34_RIGHT
```
